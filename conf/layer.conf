## conf/layer.conf
```bitbake
BBPATH .= ":${LAYERDIR}"

BBFILES += "${LAYERDIR}/recipes-*/*/*.bb \
            ${LAYERDIR}/recipes-*/*/*.bbappend"

BBFILE_COLLECTIONS += "meta-algebra"
BBFILE_PATTERN_meta-algebra = "^${LAYERDIR}/"
BBFILE_PRIORITY_meta-algebra = "6"

LAYERDEPENDS_meta-algebra = "core"
LAYERSERIES_COMPAT_meta-algebra = "dunfell warrior zeus"
```
